The event handler for the following functions takes a \helpref{wxGridEvent}{wxgridevent} parameter.
The ...\_CMD\_... variants also take a window identifier.

\twocolwidtha{7cm}
\begin{twocollist}\itemsep=0pt
\twocolitem{{\bf EVT\_GRID\_CELL\_LEFT\_CLICK(func)}}{The user clicked a cell with the left mouse button. Processes a wxEVT\_GRID\_CELL\_LEFT\_CLICK.}
\twocolitem{{\bf EVT\_GRID\_CELL\_RIGHT\_CLICK(func)}}{The user clicked a cell with the right mouse button. Processes a wxEVT\_GRID\_CELL\_RIGHT\_CLICK.}
\twocolitem{{\bf EVT\_GRID\_CELL\_LEFT\_DCLICK(func)}}{The user double-clicked a cell with the left mouse button. Processes a wxEVT\_GRID\_CELL\_LEFT\_DCLICK.}
\twocolitem{{\bf EVT\_GRID\_CELL\_RIGHT\_DCLICK(func)}}{The user double-clicked a cell with the right mouse button. Processes a wxEVT\_GRID\_CELL\_RIGHT\_DCLICK.}
\twocolitem{{\bf EVT\_GRID\_LABEL\_LEFT\_CLICK(func)}}{The user clicked a label with the left mouse button. Processes a wxEVT\_GRID\_LABEL\_LEFT\_CLICK.}
\twocolitem{{\bf EVT\_GRID\_LABEL\_RIGHT\_CLICK(func)}}{The user clicked a label with the right mouse button. Processes a wxEVT\_GRID\_LABEL\_RIGHT\_CLICK.}
\twocolitem{{\bf EVT\_GRID\_LABEL\_LEFT\_DCLICK(func)}}{The user double-clicked a label with the left mouse button. Processes a wxEVT\_GRID\_LABEL\_LEFT\_DCLICK.}
\twocolitem{{\bf EVT\_GRID\_LABEL\_RIGHT\_DCLICK(func)}}{The user double-clicked a label with the right mouse button. Processes a wxEVT\_GRID\_LABEL\_RIGHT\_DCLICK.}
\twocolitem{{\bf EVT\_GRID\_CELL\_CHANGE(func)}}{The user changed the data in a cell. Processes a wxEVT\_GRID\_CELL\_CHANGE.}
\twocolitem{{\bf EVT\_GRID\_SELECT\_CELL(func)}}{The user moved to, and selected a cell. Processes a wxEVT\_GRID\_SELECT\_CELL.}
\twocolitem{{\bf EVT\_GRID\_EDITOR\_HIDDEN(func)}}{The editor for a cell was hidden. Processes a wxEVT\_GRID\_EDITOR\_HIDDEN.}
\twocolitem{{\bf EVT\_GRID\_EDITOR\_SHOWN(func)}}{The editor for a cell was shown. Processes a wxEVT\_GRID\_EDITOR\_SHOWN.}
\twocolitem{{\bf EVT\_GRID\_CMD\_CELL\_LEFT\_CLICK(id, func)}}{The user clicked a cell with the left mouse button; variant taking a window identifier. Processes a wxEVT\_GRID\_CELL\_LEFT\_CLICK.}
\twocolitem{{\bf EVT\_GRID\_CMD\_CELL\_RIGHT\_CLICK(id, func)}}{The user clicked a cell with the right mouse button; variant taking a window identifier. Processes a wxEVT\_GRID\_CELL\_RIGHT\_CLICK.}
\twocolitem{{\bf EVT\_GRID\_CMD\_CELL\_LEFT\_DCLICK(id, func)}}{The user double-clicked a cell with the left mouse button; variant taking a window identifier. Processes a wxEVT\_GRID\_CELL\_LEFT\_DCLICK.}
\twocolitem{{\bf EVT\_GRID\_CMD\_CELL\_RIGHT\_DCLICK(id, func)}}{The user double-clicked a cell with the right mouse button; variant taking a window identifier. Processes a wxEVT\_GRID\_CELL\_RIGHT\_DCLICK.}
\twocolitem{{\bf EVT\_GRID\_CMD\_LABEL\_LEFT\_CLICK(id, func)}}{The user clicked a label with the left mouse button; variant taking a window identifier. Processes a wxEVT\_GRID\_LABEL\_LEFT\_CLICK.}
\twocolitem{{\bf EVT\_GRID\_CMD\_LABEL\_RIGHT\_CLICK(id, func)}}{The user clicked a label with the right mouse button; variant taking a window identifier. Processes a wxEVT\_GRID\_LABEL\_RIGHT\_CLICK.}
\twocolitem{{\bf EVT\_GRID\_CMD\_LABEL\_LEFT\_DCLICK(id, func)}}{The user double-clicked a label with the left mouse button; variant taking a window identifier. Processes a wxEVT\_GRID\_LABEL\_LEFT\_DCLICK.}
\twocolitem{{\bf EVT\_GRID\_CMD\_LABEL\_RIGHT\_DCLICK(id, func)}}{The user double-clicked a label with the right mouse button; variant taking a window identifier. Processes a wxEVT\_GRID\_LABEL\_RIGHT\_DCLICK.}
\twocolitem{{\bf EVT\_GRID\_CMD\_CELL\_CHANGE(id, func)}}{The user changed the data in a cell; variant taking a window identifier. Processes a wxEVT\_GRID\_CELL\_CHANGE.}
\twocolitem{{\bf EVT\_GRID\_CMD\_SELECT\_CELL(id, func)}}{The user moved to, and selected a cell; variant taking a window identifier. Processes a wxEVT\_GRID\_SELECT\_CELL.}
\twocolitem{{\bf EVT\_GRID\_CMD\_EDITOR\_HIDDEN(id, func)}}{The editor for a cell was hidden; variant taking a window identifier. Processes a wxEVT\_GRID\_EDITOR\_HIDDEN.}
\twocolitem{{\bf EVT\_GRID\_CMD\_EDITOR\_SHOWN(id, func)}}{The editor for a cell was shown; variant taking a window identifier. Processes a wxEVT\_GRID\_EDITOR\_SHOWN.}
\end{twocollist}%

