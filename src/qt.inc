# needed for unactivated
NONE =

# define library name
LIB_TARGET=wx_qt
LIB_MAJOR=0
LIB_MINOR=1

# define library sources

LIB_CPP_SRC=\
\
 qt/app.cpp \
 qt/bitmap.cpp \
 qt/brush.cpp \
 qt/button.cpp \
 qt/checkbox.cpp \
 qt/choice.cpp \
 qt/colour.cpp \
 qt/control.cpp \
 qt/combobox.cpp \
 qt/cursor.cpp \
 qt/data.cpp \
 qt/dc.cpp \
 qt/dcclient.cpp \
 qt/dcmemory.cpp \
 qt/dcscreen.cpp \
 qt/dnd.cpp \
 qt/dialog.cpp \
 qt/filedlg.cpp \
 qt/font.cpp \
 qt/frame.cpp \
 qt/gauge.cpp \
 qt/gdiobj.cpp \
 qt/icon.cpp \
 qt/listbox.cpp \
 qt/mdi.cpp \
 qt/menu.cpp \
 qt/notebook.cpp \
 qt/palette.cpp \
 qt/pen.cpp \
 qt/radiobox.cpp \
 qt/radiobut.cpp \
 qt/region.cpp \
 qt/scrolbar.cpp \
 qt/settings.cpp \
 qt/slider.cpp \
 qt/statbox.cpp \
 qt/stattext.cpp \
 qt/tbargtk.cpp \
 qt/textctrl.cpp \
 qt/timer.cpp \
 qt/utilsgtk.cpp \
 qt/utilsres.cpp \
 qt/window.cpp \
\

 
LIB_C_SRC=\
\
 png/png.c \
 png/pngset.c \
 png/pngget.c \
 png/pngrutil.c \
 png/pngtrans.c \
 png/pngwutil.c \
 png/pngread.c \
 png/pngrio.c \
 png/pngwio.c \
 png/pngwrite.c \
 png/pngrtran.c \
 png/pngwtran.c \
 png/pngmem.c \
 png/pngerror.c \
 png/pngpread.c \
\
 zlib/adler32.c \
 zlib/compress.c \
 zlib/crc32.c \
 zlib/gzio.c \
 zlib/uncompr.c \
 zlib/deflate.c \
 zlib/trees.c \
 zlib/zutil.c \
 zlib/inflate.c \
 zlib/infblock.c \
 zlib/inftrees.c \
 zlib/infcodes.c \
 zlib/infutil.c \
 zlib/inffast.c \
\
 iodbc/dlf.c \
 iodbc/dlproc.c \
 iodbc/herr.c \
 iodbc/henv.c \
 iodbc/hdbc.c \
 iodbc/hstmt.c \
 iodbc/connect.c \
 iodbc/prepare.c \
 iodbc/result.c \
 iodbc/execute.c \
 iodbc/fetch.c \
 iodbc/info.c \
 iodbc/catalog.c \
 iodbc/misc.c \
 iodbc/itrace.c
